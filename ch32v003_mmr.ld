SECTIONS {
	.pwr_ctlr 0x40007000 (NOLOAD): ALIGN(4) { KEEP(*(.pwr_ctlr)) }
	.pwr_csr 0x40007004 (NOLOAD): ALIGN(4) { KEEP(*(.pwr_csr)) }
	.pwr_awucsr 0x40007008 (NOLOAD): ALIGN(4) { KEEP(*(.pwr_awucsr)) }
	.pwr_awuapr 0x4000700c (NOLOAD): ALIGN(4) { KEEP(*(.pwr_awuapr)) }
	.pwr_awupsc 0x40007010 (NOLOAD): ALIGN(4) { KEEP(*(.pwr_awupsc)) }
	.rcc_ctlr 0x40021000 (NOLOAD): ALIGN(4) { KEEP(*(.rcc_ctlr)) }
	.rcc_cfgr0 0x40021004 (NOLOAD): ALIGN(4) { KEEP(*(.rcc_cfgr0)) }
	.rcc_intr 0x40021008 (NOLOAD): ALIGN(4) { KEEP(*(.rcc_intr)) }
	.rcc_apb2prstr 0x4002100c (NOLOAD): ALIGN(4) { KEEP(*(.rcc_apb2prstr)) }
	.rcc_apb1prstr 0x40021010 (NOLOAD): ALIGN(4) { KEEP(*(.rcc_apb1prstr)) }
	.rcc_ahbpcenr 0x40021014 (NOLOAD): ALIGN(4) { KEEP(*(.rcc_ahbpcenr)) }
	.rcc_apb2pcenr 0x40021018 (NOLOAD): ALIGN(4) { KEEP(*(.rcc_apb2pcenr)) }
	.rcc_apb1pcenr 0x4002101c (NOLOAD): ALIGN(4) { KEEP(*(.rcc_apb1pcenr)) }
	.rcc_rstsckr 0x40021024 (NOLOAD): ALIGN(4) { KEEP(*(.rcc_rstsckr)) }
	.extend_extend_ctr 0x40023800 (NOLOAD): ALIGN(4) { KEEP(*(.extend_extend_ctr)) }
	.extend_extend_kr 0x40023804 (NOLOAD): ALIGN(4) { KEEP(*(.extend_extend_kr)) }
	.gpioa_cfglr 0x40010800 (NOLOAD): ALIGN(4) { KEEP(*(.gpioa_cfglr)) }
	.gpioa_indr 0x40010808 (NOLOAD): ALIGN(4) { KEEP(*(.gpioa_indr)) }
	.gpioa_outdr 0x4001080c (NOLOAD): ALIGN(4) { KEEP(*(.gpioa_outdr)) }
	.gpioa_bshr 0x40010810 (NOLOAD): ALIGN(4) { KEEP(*(.gpioa_bshr)) }
	.gpioa_bcr 0x40010814 (NOLOAD): ALIGN(4) { KEEP(*(.gpioa_bcr)) }
	.gpioa_lckr 0x40010818 (NOLOAD): ALIGN(4) { KEEP(*(.gpioa_lckr)) }
	.gpioc_cfglr 0x40011000 (NOLOAD): ALIGN(4) { KEEP(*(.gpioc_cfglr)) }
	.gpioc_indr 0x40011008 (NOLOAD): ALIGN(4) { KEEP(*(.gpioc_indr)) }
	.gpioc_outdr 0x4001100c (NOLOAD): ALIGN(4) { KEEP(*(.gpioc_outdr)) }
	.gpioc_bshr 0x40011010 (NOLOAD): ALIGN(4) { KEEP(*(.gpioc_bshr)) }
	.gpioc_bcr 0x40011014 (NOLOAD): ALIGN(4) { KEEP(*(.gpioc_bcr)) }
	.gpioc_lckr 0x40011018 (NOLOAD): ALIGN(4) { KEEP(*(.gpioc_lckr)) }
	.gpiod_cfglr 0x40011400 (NOLOAD): ALIGN(4) { KEEP(*(.gpiod_cfglr)) }
	.gpiod_indr 0x40011408 (NOLOAD): ALIGN(4) { KEEP(*(.gpiod_indr)) }
	.gpiod_outdr 0x4001140c (NOLOAD): ALIGN(4) { KEEP(*(.gpiod_outdr)) }
	.gpiod_bshr 0x40011410 (NOLOAD): ALIGN(4) { KEEP(*(.gpiod_bshr)) }
	.gpiod_bcr 0x40011414 (NOLOAD): ALIGN(4) { KEEP(*(.gpiod_bcr)) }
	.gpiod_lckr 0x40011418 (NOLOAD): ALIGN(4) { KEEP(*(.gpiod_lckr)) }
	.afio_pcfr 0x40010004 (NOLOAD): ALIGN(4) { KEEP(*(.afio_pcfr)) }
	.afio_exticr 0x40010008 (NOLOAD): ALIGN(4) { KEEP(*(.afio_exticr)) }
	.exti_intenr 0x40010400 (NOLOAD): ALIGN(4) { KEEP(*(.exti_intenr)) }
	.exti_evenr 0x40010404 (NOLOAD): ALIGN(4) { KEEP(*(.exti_evenr)) }
	.exti_rtenr 0x40010408 (NOLOAD): ALIGN(4) { KEEP(*(.exti_rtenr)) }
	.exti_ftenr 0x4001040c (NOLOAD): ALIGN(4) { KEEP(*(.exti_ftenr)) }
	.exti_swievr 0x40010410 (NOLOAD): ALIGN(4) { KEEP(*(.exti_swievr)) }
	.exti_intfr 0x40010414 (NOLOAD): ALIGN(4) { KEEP(*(.exti_intfr)) }
	.dma1_intfr 0x40020000 (NOLOAD): ALIGN(4) { KEEP(*(.dma1_intfr)) }
	.dma1_intfcr 0x40020004 (NOLOAD): ALIGN(4) { KEEP(*(.dma1_intfcr)) }
	.dma1_cfgr1 0x40020008 (NOLOAD): ALIGN(4) { KEEP(*(.dma1_cfgr1)) }
	.dma1_cntr1 0x4002000c (NOLOAD): ALIGN(4) { KEEP(*(.dma1_cntr1)) }
	.dma1_paddr1 0x40020010 (NOLOAD): ALIGN(4) { KEEP(*(.dma1_paddr1)) }
	.dma1_maddr1 0x40020014 (NOLOAD): ALIGN(4) { KEEP(*(.dma1_maddr1)) }
	.dma1_cfgr2 0x4002001c (NOLOAD): ALIGN(4) { KEEP(*(.dma1_cfgr2)) }
	.dma1_cntr2 0x40020020 (NOLOAD): ALIGN(4) { KEEP(*(.dma1_cntr2)) }
	.dma1_paddr2 0x40020024 (NOLOAD): ALIGN(4) { KEEP(*(.dma1_paddr2)) }
	.dma1_maddr2 0x40020028 (NOLOAD): ALIGN(4) { KEEP(*(.dma1_maddr2)) }
	.dma1_cfgr3 0x40020030 (NOLOAD): ALIGN(4) { KEEP(*(.dma1_cfgr3)) }
	.dma1_cntr3 0x40020034 (NOLOAD): ALIGN(4) { KEEP(*(.dma1_cntr3)) }
	.dma1_paddr3 0x40020038 (NOLOAD): ALIGN(4) { KEEP(*(.dma1_paddr3)) }
	.dma1_maddr3 0x4002003c (NOLOAD): ALIGN(4) { KEEP(*(.dma1_maddr3)) }
	.dma1_cfgr4 0x40020044 (NOLOAD): ALIGN(4) { KEEP(*(.dma1_cfgr4)) }
	.dma1_cntr4 0x40020048 (NOLOAD): ALIGN(4) { KEEP(*(.dma1_cntr4)) }
	.dma1_paddr4 0x4002004c (NOLOAD): ALIGN(4) { KEEP(*(.dma1_paddr4)) }
	.dma1_maddr4 0x40020050 (NOLOAD): ALIGN(4) { KEEP(*(.dma1_maddr4)) }
	.dma1_cfgr5 0x40020058 (NOLOAD): ALIGN(4) { KEEP(*(.dma1_cfgr5)) }
	.dma1_cntr5 0x4002005c (NOLOAD): ALIGN(4) { KEEP(*(.dma1_cntr5)) }
	.dma1_paddr5 0x40020060 (NOLOAD): ALIGN(4) { KEEP(*(.dma1_paddr5)) }
	.dma1_maddr5 0x40020064 (NOLOAD): ALIGN(4) { KEEP(*(.dma1_maddr5)) }
	.dma1_cfgr6 0x4002006c (NOLOAD): ALIGN(4) { KEEP(*(.dma1_cfgr6)) }
	.dma1_cntr6 0x40020070 (NOLOAD): ALIGN(4) { KEEP(*(.dma1_cntr6)) }
	.dma1_paddr6 0x40020074 (NOLOAD): ALIGN(4) { KEEP(*(.dma1_paddr6)) }
	.dma1_maddr6 0x40020078 (NOLOAD): ALIGN(4) { KEEP(*(.dma1_maddr6)) }
	.dma1_cfgr7 0x40020080 (NOLOAD): ALIGN(4) { KEEP(*(.dma1_cfgr7)) }
	.dma1_cntr7 0x40020084 (NOLOAD): ALIGN(4) { KEEP(*(.dma1_cntr7)) }
	.dma1_paddr7 0x40020088 (NOLOAD): ALIGN(4) { KEEP(*(.dma1_paddr7)) }
	.dma1_maddr7 0x4002008c (NOLOAD): ALIGN(4) { KEEP(*(.dma1_maddr7)) }
	.iwdg_ctlr 0x40003000 (NOLOAD): ALIGN(4) { KEEP(*(.iwdg_ctlr)) }
	.iwdg_pscr 0x40003004 (NOLOAD): ALIGN(4) { KEEP(*(.iwdg_pscr)) }
	.iwdg_rldr 0x40003008 (NOLOAD): ALIGN(4) { KEEP(*(.iwdg_rldr)) }
	.iwdg_statr 0x4000300c (NOLOAD): ALIGN(4) { KEEP(*(.iwdg_statr)) }
	.wwdg_ctlr 0x40002c00 (NOLOAD): ALIGN(4) { KEEP(*(.wwdg_ctlr)) }
	.wwdg_cfgr 0x40002c04 (NOLOAD): ALIGN(4) { KEEP(*(.wwdg_cfgr)) }
	.wwdg_statr 0x40002c08 (NOLOAD): ALIGN(4) { KEEP(*(.wwdg_statr)) }
	.tim1_ctlr1 0x40012c00 (NOLOAD): ALIGN(4) { KEEP(*(.tim1_ctlr1)) }
	.tim1_ctlr2 0x40012c04 (NOLOAD): ALIGN(4) { KEEP(*(.tim1_ctlr2)) }
	.tim1_smcfgr 0x40012c08 (NOLOAD): ALIGN(4) { KEEP(*(.tim1_smcfgr)) }
	.tim1_dmaintenr 0x40012c0c (NOLOAD): ALIGN(4) { KEEP(*(.tim1_dmaintenr)) }
	.tim1_intfr 0x40012c10 (NOLOAD): ALIGN(4) { KEEP(*(.tim1_intfr)) }
	.tim1_swevgr 0x40012c14 (NOLOAD): ALIGN(4) { KEEP(*(.tim1_swevgr)) }
	.tim1_chctlr1 0x40012c18 (NOLOAD): ALIGN(4) { KEEP(*(.tim1_chctlr1)) }
	.tim1_chctlr2 0x40012c1c (NOLOAD): ALIGN(4) { KEEP(*(.tim1_chctlr2)) }
	.tim1_ccer 0x40012c20 (NOLOAD): ALIGN(4) { KEEP(*(.tim1_ccer)) }
	.tim1_cnt 0x40012c24 (NOLOAD): ALIGN(4) { KEEP(*(.tim1_cnt)) }
	.tim1_psc 0x40012c28 (NOLOAD): ALIGN(4) { KEEP(*(.tim1_psc)) }
	.tim1_atrlr 0x40012c2c (NOLOAD): ALIGN(4) { KEEP(*(.tim1_atrlr)) }
	.tim1_rptcr 0x40012c30 (NOLOAD): ALIGN(4) { KEEP(*(.tim1_rptcr)) }
	.tim1_ch1cvr 0x40012c34 (NOLOAD): ALIGN(4) { KEEP(*(.tim1_ch1cvr)) }
	.tim1_ch2cvr 0x40012c38 (NOLOAD): ALIGN(4) { KEEP(*(.tim1_ch2cvr)) }
	.tim1_ch3cvr 0x40012c3c (NOLOAD): ALIGN(4) { KEEP(*(.tim1_ch3cvr)) }
	.tim1_ch4cvr 0x40012c40 (NOLOAD): ALIGN(4) { KEEP(*(.tim1_ch4cvr)) }
	.tim1_bdtr 0x40012c44 (NOLOAD): ALIGN(4) { KEEP(*(.tim1_bdtr)) }
	.tim1_dmacfgr 0x40012c48 (NOLOAD): ALIGN(4) { KEEP(*(.tim1_dmacfgr)) }
	.tim1_dmaadr 0x40012c4c (NOLOAD): ALIGN(4) { KEEP(*(.tim1_dmaadr)) }
	.tim2_ctlr1 0x40000000 (NOLOAD): ALIGN(4) { KEEP(*(.tim2_ctlr1)) }
	.tim2_ctlr2 0x40000004 (NOLOAD): ALIGN(4) { KEEP(*(.tim2_ctlr2)) }
	.tim2_smcfgr 0x40000008 (NOLOAD): ALIGN(4) { KEEP(*(.tim2_smcfgr)) }
	.tim2_dmaintenr 0x4000000c (NOLOAD): ALIGN(4) { KEEP(*(.tim2_dmaintenr)) }
	.tim2_intfr 0x40000010 (NOLOAD): ALIGN(4) { KEEP(*(.tim2_intfr)) }
	.tim2_swevgr 0x40000014 (NOLOAD): ALIGN(4) { KEEP(*(.tim2_swevgr)) }
	.tim2_chctlr1 0x40000018 (NOLOAD): ALIGN(4) { KEEP(*(.tim2_chctlr1)) }
	.tim2_chctlr2 0x4000001c (NOLOAD): ALIGN(4) { KEEP(*(.tim2_chctlr2)) }
	.tim2_ccer 0x40000020 (NOLOAD): ALIGN(4) { KEEP(*(.tim2_ccer)) }
	.tim2_cnt 0x40000024 (NOLOAD): ALIGN(4) { KEEP(*(.tim2_cnt)) }
	.tim2_psc 0x40000028 (NOLOAD): ALIGN(4) { KEEP(*(.tim2_psc)) }
	.tim2_atrlr 0x4000002c (NOLOAD): ALIGN(4) { KEEP(*(.tim2_atrlr)) }
	.tim2_ch1cvr 0x40000034 (NOLOAD): ALIGN(4) { KEEP(*(.tim2_ch1cvr)) }
	.tim2_ch2cvr 0x40000038 (NOLOAD): ALIGN(4) { KEEP(*(.tim2_ch2cvr)) }
	.tim2_ch3cvr 0x4000003c (NOLOAD): ALIGN(4) { KEEP(*(.tim2_ch3cvr)) }
	.tim2_ch4cvr 0x40000040 (NOLOAD): ALIGN(4) { KEEP(*(.tim2_ch4cvr)) }
	.tim2_dmacfgr 0x40000048 (NOLOAD): ALIGN(4) { KEEP(*(.tim2_dmacfgr)) }
	.tim2_dmaadr 0x4000004c (NOLOAD): ALIGN(4) { KEEP(*(.tim2_dmaadr)) }
	.i2c1_ctlr1 0x40005400 (NOLOAD): ALIGN(4) { KEEP(*(.i2c1_ctlr1)) }
	.i2c1_ctlr2 0x40005404 (NOLOAD): ALIGN(4) { KEEP(*(.i2c1_ctlr2)) }
	.i2c1_oaddr1 0x40005408 (NOLOAD): ALIGN(4) { KEEP(*(.i2c1_oaddr1)) }
	.i2c1_oaddr2 0x4000540c (NOLOAD): ALIGN(4) { KEEP(*(.i2c1_oaddr2)) }
	.i2c1_datar 0x40005410 (NOLOAD): ALIGN(4) { KEEP(*(.i2c1_datar)) }
	.i2c1_star1 0x40005414 (NOLOAD): ALIGN(4) { KEEP(*(.i2c1_star1)) }
	.i2c1_star2 0x40005418 (NOLOAD): ALIGN(4) { KEEP(*(.i2c1_star2)) }
	.i2c1_ckcfgr 0x4000541c (NOLOAD): ALIGN(4) { KEEP(*(.i2c1_ckcfgr)) }
	.spi1_ctlr1 0x40013000 (NOLOAD): ALIGN(4) { KEEP(*(.spi1_ctlr1)) }
	.spi1_ctlr2 0x40013004 (NOLOAD): ALIGN(4) { KEEP(*(.spi1_ctlr2)) }
	.spi1_statr 0x40013008 (NOLOAD): ALIGN(4) { KEEP(*(.spi1_statr)) }
	.spi1_datar 0x4001300c (NOLOAD): ALIGN(4) { KEEP(*(.spi1_datar)) }
	.spi1_crcr 0x40013010 (NOLOAD): ALIGN(4) { KEEP(*(.spi1_crcr)) }
	.spi1_rcrcr 0x40013014 (NOLOAD): ALIGN(4) { KEEP(*(.spi1_rcrcr)) }
	.spi1_tcrcr 0x40013018 (NOLOAD): ALIGN(4) { KEEP(*(.spi1_tcrcr)) }
	.spi1_hscr 0x40013024 (NOLOAD): ALIGN(4) { KEEP(*(.spi1_hscr)) }
	.usart1_statr 0x40013800 (NOLOAD): ALIGN(4) { KEEP(*(.usart1_statr)) }
	.usart1_datar 0x40013804 (NOLOAD): ALIGN(4) { KEEP(*(.usart1_datar)) }
	.usart1_brr 0x40013808 (NOLOAD): ALIGN(4) { KEEP(*(.usart1_brr)) }
	.usart1_ctlr1 0x4001380c (NOLOAD): ALIGN(4) { KEEP(*(.usart1_ctlr1)) }
	.usart1_ctlr2 0x40013810 (NOLOAD): ALIGN(4) { KEEP(*(.usart1_ctlr2)) }
	.usart1_ctlr3 0x40013814 (NOLOAD): ALIGN(4) { KEEP(*(.usart1_ctlr3)) }
	.usart1_gpr 0x40013818 (NOLOAD): ALIGN(4) { KEEP(*(.usart1_gpr)) }
	.adc1_statr 0x40012400 (NOLOAD): ALIGN(4) { KEEP(*(.adc1_statr)) }
	.adc1_ctlr1 0x40012404 (NOLOAD): ALIGN(4) { KEEP(*(.adc1_ctlr1)) }
	.adc1_ctlr2 0x40012408 (NOLOAD): ALIGN(4) { KEEP(*(.adc1_ctlr2)) }
	.adc1_samptr1_charge1 0x4001240c (NOLOAD): ALIGN(4) { KEEP(*(.adc1_samptr1_charge1)) }
	.adc1_samptr2_charge2 0x40012410 (NOLOAD): ALIGN(4) { KEEP(*(.adc1_samptr2_charge2)) }
	.adc1_iofr1 0x40012414 (NOLOAD): ALIGN(4) { KEEP(*(.adc1_iofr1)) }
	.adc1_iofr2 0x40012418 (NOLOAD): ALIGN(4) { KEEP(*(.adc1_iofr2)) }
	.adc1_iofr3 0x4001241c (NOLOAD): ALIGN(4) { KEEP(*(.adc1_iofr3)) }
	.adc1_iofr4 0x40012420 (NOLOAD): ALIGN(4) { KEEP(*(.adc1_iofr4)) }
	.adc1_wdhtr 0x40012424 (NOLOAD): ALIGN(4) { KEEP(*(.adc1_wdhtr)) }
	.adc1_wdltr 0x40012428 (NOLOAD): ALIGN(4) { KEEP(*(.adc1_wdltr)) }
	.adc1_rsqr1 0x4001242c (NOLOAD): ALIGN(4) { KEEP(*(.adc1_rsqr1)) }
	.adc1_rsqr2 0x40012430 (NOLOAD): ALIGN(4) { KEEP(*(.adc1_rsqr2)) }
	.adc1_rsqr3 0x40012434 (NOLOAD): ALIGN(4) { KEEP(*(.adc1_rsqr3)) }
	.adc1_isqr 0x40012438 (NOLOAD): ALIGN(4) { KEEP(*(.adc1_isqr)) }
	.adc1_idatar1 0x4001243c (NOLOAD): ALIGN(4) { KEEP(*(.adc1_idatar1)) }
	.adc1_idatar2 0x40012440 (NOLOAD): ALIGN(4) { KEEP(*(.adc1_idatar2)) }
	.adc1_idatar3 0x40012444 (NOLOAD): ALIGN(4) { KEEP(*(.adc1_idatar3)) }
	.adc1_idatar4 0x40012448 (NOLOAD): ALIGN(4) { KEEP(*(.adc1_idatar4)) }
	.adc1_rdatar 0x4001244c (NOLOAD): ALIGN(4) { KEEP(*(.adc1_rdatar)) }
	.adc1_dlyr 0x40012450 (NOLOAD): ALIGN(4) { KEEP(*(.adc1_dlyr)) }
	.dbg_cfgr1 0xe000d000 (NOLOAD): ALIGN(4) { KEEP(*(.dbg_cfgr1)) }
	.dbg_cfgr2 0xe000d004 (NOLOAD): ALIGN(4) { KEEP(*(.dbg_cfgr2)) }
	.esig_flacap 0x1ffff7e0 (NOLOAD): ALIGN(4) { KEEP(*(.esig_flacap)) }
	.esig_uniid1 0x1ffff7e8 (NOLOAD): ALIGN(4) { KEEP(*(.esig_uniid1)) }
	.esig_uniid2 0x1ffff7ec (NOLOAD): ALIGN(4) { KEEP(*(.esig_uniid2)) }
	.esig_uniid3 0x1ffff7f0 (NOLOAD): ALIGN(4) { KEEP(*(.esig_uniid3)) }
	.flash_actlr 0x40022000 (NOLOAD): ALIGN(4) { KEEP(*(.flash_actlr)) }
	.flash_keyr 0x40022004 (NOLOAD): ALIGN(4) { KEEP(*(.flash_keyr)) }
	.flash_obkeyr 0x40022008 (NOLOAD): ALIGN(4) { KEEP(*(.flash_obkeyr)) }
	.flash_statr 0x4002200c (NOLOAD): ALIGN(4) { KEEP(*(.flash_statr)) }
	.flash_ctlr 0x40022010 (NOLOAD): ALIGN(4) { KEEP(*(.flash_ctlr)) }
	.flash_addr 0x40022014 (NOLOAD): ALIGN(4) { KEEP(*(.flash_addr)) }
	.flash_obr 0x4002201c (NOLOAD): ALIGN(4) { KEEP(*(.flash_obr)) }
	.flash_wpr 0x40022020 (NOLOAD): ALIGN(4) { KEEP(*(.flash_wpr)) }
	.flash_modekeyr 0x40022024 (NOLOAD): ALIGN(4) { KEEP(*(.flash_modekeyr)) }
	.flash_boot_modekeyp 0x40022028 (NOLOAD): ALIGN(4) { KEEP(*(.flash_boot_modekeyp)) }
	.pfic_isr1 0xe000e000 (NOLOAD): ALIGN(4) { KEEP(*(.pfic_isr1)) }
	.pfic_isr2 0xe000e004 (NOLOAD): ALIGN(4) { KEEP(*(.pfic_isr2)) }
	.pfic_isr3 0xe000e008 (NOLOAD): ALIGN(4) { KEEP(*(.pfic_isr3)) }
	.pfic_isr4 0xe000e00c (NOLOAD): ALIGN(4) { KEEP(*(.pfic_isr4)) }
	.pfic_ipr1 0xe000e020 (NOLOAD): ALIGN(4) { KEEP(*(.pfic_ipr1)) }
	.pfic_ipr2 0xe000e024 (NOLOAD): ALIGN(4) { KEEP(*(.pfic_ipr2)) }
	.pfic_ipr3 0xe000e028 (NOLOAD): ALIGN(4) { KEEP(*(.pfic_ipr3)) }
	.pfic_ipr4 0xe000e02c (NOLOAD): ALIGN(4) { KEEP(*(.pfic_ipr4)) }
	.pfic_ithresdr 0xe000e040 (NOLOAD): ALIGN(4) { KEEP(*(.pfic_ithresdr)) }
	.pfic_cfgr 0xe000e048 (NOLOAD): ALIGN(4) { KEEP(*(.pfic_cfgr)) }
	.pfic_gisr 0xe000e04c (NOLOAD): ALIGN(4) { KEEP(*(.pfic_gisr)) }
	.pfic_vtfidr 0xe000e050 (NOLOAD): ALIGN(4) { KEEP(*(.pfic_vtfidr)) }
	.pfic_vtfaddrr0 0xe000e060 (NOLOAD): ALIGN(4) { KEEP(*(.pfic_vtfaddrr0)) }
	.pfic_vtfaddrr1 0xe000e064 (NOLOAD): ALIGN(4) { KEEP(*(.pfic_vtfaddrr1)) }
	.pfic_vtfaddrr2 0xe000e068 (NOLOAD): ALIGN(4) { KEEP(*(.pfic_vtfaddrr2)) }
	.pfic_vtfaddrr3 0xe000e06c (NOLOAD): ALIGN(4) { KEEP(*(.pfic_vtfaddrr3)) }
	.pfic_ienr1 0xe000e100 (NOLOAD): ALIGN(4) { KEEP(*(.pfic_ienr1)) }
	.pfic_ienr2 0xe000e104 (NOLOAD): ALIGN(4) { KEEP(*(.pfic_ienr2)) }
	.pfic_ienr3 0xe000e108 (NOLOAD): ALIGN(4) { KEEP(*(.pfic_ienr3)) }
	.pfic_ienr4 0xe000e10c (NOLOAD): ALIGN(4) { KEEP(*(.pfic_ienr4)) }
	.pfic_irer1 0xe000e180 (NOLOAD): ALIGN(4) { KEEP(*(.pfic_irer1)) }
	.pfic_irer2 0xe000e184 (NOLOAD): ALIGN(4) { KEEP(*(.pfic_irer2)) }
	.pfic_irer3 0xe000e188 (NOLOAD): ALIGN(4) { KEEP(*(.pfic_irer3)) }
	.pfic_irer4 0xe000e18c (NOLOAD): ALIGN(4) { KEEP(*(.pfic_irer4)) }
	.pfic_ipsr1 0xe000e200 (NOLOAD): ALIGN(4) { KEEP(*(.pfic_ipsr1)) }
	.pfic_ipsr2 0xe000e204 (NOLOAD): ALIGN(4) { KEEP(*(.pfic_ipsr2)) }
	.pfic_ipsr3 0xe000e208 (NOLOAD): ALIGN(4) { KEEP(*(.pfic_ipsr3)) }
	.pfic_ipsr4 0xe000e20c (NOLOAD): ALIGN(4) { KEEP(*(.pfic_ipsr4)) }
	.pfic_iprr1 0xe000e280 (NOLOAD): ALIGN(4) { KEEP(*(.pfic_iprr1)) }
	.pfic_iprr2 0xe000e284 (NOLOAD): ALIGN(4) { KEEP(*(.pfic_iprr2)) }
	.pfic_iprr3 0xe000e288 (NOLOAD): ALIGN(4) { KEEP(*(.pfic_iprr3)) }
	.pfic_iprr4 0xe000e28c (NOLOAD): ALIGN(4) { KEEP(*(.pfic_iprr4)) }
	.pfic_iactr1 0xe000e300 (NOLOAD): ALIGN(4) { KEEP(*(.pfic_iactr1)) }
	.pfic_iactr2 0xe000e304 (NOLOAD): ALIGN(4) { KEEP(*(.pfic_iactr2)) }
	.pfic_iactr3 0xe000e308 (NOLOAD): ALIGN(4) { KEEP(*(.pfic_iactr3)) }
	.pfic_iactr4 0xe000e30c (NOLOAD): ALIGN(4) { KEEP(*(.pfic_iactr4)) }
	.pfic_iprior0 0xe000e400 (NOLOAD): ALIGN(4) { KEEP(*(.pfic_iprior0)) }
	.pfic_iprior1 0xe000e401 (NOLOAD): ALIGN(4) { KEEP(*(.pfic_iprior1)) }
	.pfic_iprior2 0xe000e402 (NOLOAD): ALIGN(4) { KEEP(*(.pfic_iprior2)) }
	.pfic_iprior3 0xe000e403 (NOLOAD): ALIGN(4) { KEEP(*(.pfic_iprior3)) }
	.pfic_iprior4 0xe000e404 (NOLOAD): ALIGN(4) { KEEP(*(.pfic_iprior4)) }
	.pfic_iprior5 0xe000e405 (NOLOAD): ALIGN(4) { KEEP(*(.pfic_iprior5)) }
	.pfic_iprior6 0xe000e406 (NOLOAD): ALIGN(4) { KEEP(*(.pfic_iprior6)) }
	.pfic_iprior7 0xe000e407 (NOLOAD): ALIGN(4) { KEEP(*(.pfic_iprior7)) }
	.pfic_iprior8 0xe000e408 (NOLOAD): ALIGN(4) { KEEP(*(.pfic_iprior8)) }
	.pfic_iprior9 0xe000e409 (NOLOAD): ALIGN(4) { KEEP(*(.pfic_iprior9)) }
	.pfic_iprior10 0xe000e40a (NOLOAD): ALIGN(4) { KEEP(*(.pfic_iprior10)) }
	.pfic_iprior11 0xe000e40b (NOLOAD): ALIGN(4) { KEEP(*(.pfic_iprior11)) }
	.pfic_iprior12 0xe000e40c (NOLOAD): ALIGN(4) { KEEP(*(.pfic_iprior12)) }
	.pfic_iprior13 0xe000e40d (NOLOAD): ALIGN(4) { KEEP(*(.pfic_iprior13)) }
	.pfic_iprior14 0xe000e40e (NOLOAD): ALIGN(4) { KEEP(*(.pfic_iprior14)) }
	.pfic_iprior15 0xe000e40f (NOLOAD): ALIGN(4) { KEEP(*(.pfic_iprior15)) }
	.pfic_iprior16 0xe000e410 (NOLOAD): ALIGN(4) { KEEP(*(.pfic_iprior16)) }
	.pfic_iprior17 0xe000e411 (NOLOAD): ALIGN(4) { KEEP(*(.pfic_iprior17)) }
	.pfic_iprior18 0xe000e412 (NOLOAD): ALIGN(4) { KEEP(*(.pfic_iprior18)) }
	.pfic_iprior19 0xe000e413 (NOLOAD): ALIGN(4) { KEEP(*(.pfic_iprior19)) }
	.pfic_iprior20 0xe000e414 (NOLOAD): ALIGN(4) { KEEP(*(.pfic_iprior20)) }
	.pfic_iprior21 0xe000e415 (NOLOAD): ALIGN(4) { KEEP(*(.pfic_iprior21)) }
	.pfic_iprior22 0xe000e416 (NOLOAD): ALIGN(4) { KEEP(*(.pfic_iprior22)) }
	.pfic_iprior23 0xe000e417 (NOLOAD): ALIGN(4) { KEEP(*(.pfic_iprior23)) }
	.pfic_iprior24 0xe000e418 (NOLOAD): ALIGN(4) { KEEP(*(.pfic_iprior24)) }
	.pfic_iprior25 0xe000e419 (NOLOAD): ALIGN(4) { KEEP(*(.pfic_iprior25)) }
	.pfic_iprior26 0xe000e41a (NOLOAD): ALIGN(4) { KEEP(*(.pfic_iprior26)) }
	.pfic_iprior27 0xe000e41b (NOLOAD): ALIGN(4) { KEEP(*(.pfic_iprior27)) }
	.pfic_iprior28 0xe000e41c (NOLOAD): ALIGN(4) { KEEP(*(.pfic_iprior28)) }
	.pfic_iprior29 0xe000e41d (NOLOAD): ALIGN(4) { KEEP(*(.pfic_iprior29)) }
	.pfic_iprior30 0xe000e41e (NOLOAD): ALIGN(4) { KEEP(*(.pfic_iprior30)) }
	.pfic_iprior31 0xe000e41f (NOLOAD): ALIGN(4) { KEEP(*(.pfic_iprior31)) }
	.pfic_iprior32 0xe000e420 (NOLOAD): ALIGN(4) { KEEP(*(.pfic_iprior32)) }
	.pfic_iprior33 0xe000e421 (NOLOAD): ALIGN(4) { KEEP(*(.pfic_iprior33)) }
	.pfic_iprior34 0xe000e422 (NOLOAD): ALIGN(4) { KEEP(*(.pfic_iprior34)) }
	.pfic_iprior35 0xe000e423 (NOLOAD): ALIGN(4) { KEEP(*(.pfic_iprior35)) }
	.pfic_iprior36 0xe000e424 (NOLOAD): ALIGN(4) { KEEP(*(.pfic_iprior36)) }
	.pfic_iprior37 0xe000e425 (NOLOAD): ALIGN(4) { KEEP(*(.pfic_iprior37)) }
	.pfic_iprior38 0xe000e426 (NOLOAD): ALIGN(4) { KEEP(*(.pfic_iprior38)) }
	.pfic_iprior39 0xe000e427 (NOLOAD): ALIGN(4) { KEEP(*(.pfic_iprior39)) }
	.pfic_iprior40 0xe000e428 (NOLOAD): ALIGN(4) { KEEP(*(.pfic_iprior40)) }
	.pfic_iprior41 0xe000e429 (NOLOAD): ALIGN(4) { KEEP(*(.pfic_iprior41)) }
	.pfic_iprior42 0xe000e42a (NOLOAD): ALIGN(4) { KEEP(*(.pfic_iprior42)) }
	.pfic_iprior43 0xe000e42b (NOLOAD): ALIGN(4) { KEEP(*(.pfic_iprior43)) }
	.pfic_iprior44 0xe000e42c (NOLOAD): ALIGN(4) { KEEP(*(.pfic_iprior44)) }
	.pfic_iprior45 0xe000e42d (NOLOAD): ALIGN(4) { KEEP(*(.pfic_iprior45)) }
	.pfic_iprior46 0xe000e42e (NOLOAD): ALIGN(4) { KEEP(*(.pfic_iprior46)) }
	.pfic_iprior47 0xe000e42f (NOLOAD): ALIGN(4) { KEEP(*(.pfic_iprior47)) }
	.pfic_iprior48 0xe000e430 (NOLOAD): ALIGN(4) { KEEP(*(.pfic_iprior48)) }
	.pfic_iprior49 0xe000e431 (NOLOAD): ALIGN(4) { KEEP(*(.pfic_iprior49)) }
	.pfic_iprior50 0xe000e432 (NOLOAD): ALIGN(4) { KEEP(*(.pfic_iprior50)) }
	.pfic_iprior51 0xe000e433 (NOLOAD): ALIGN(4) { KEEP(*(.pfic_iprior51)) }
	.pfic_iprior52 0xe000e434 (NOLOAD): ALIGN(4) { KEEP(*(.pfic_iprior52)) }
	.pfic_iprior53 0xe000e435 (NOLOAD): ALIGN(4) { KEEP(*(.pfic_iprior53)) }
	.pfic_iprior54 0xe000e436 (NOLOAD): ALIGN(4) { KEEP(*(.pfic_iprior54)) }
	.pfic_iprior55 0xe000e437 (NOLOAD): ALIGN(4) { KEEP(*(.pfic_iprior55)) }
	.pfic_iprior56 0xe000e438 (NOLOAD): ALIGN(4) { KEEP(*(.pfic_iprior56)) }
	.pfic_iprior57 0xe000e439 (NOLOAD): ALIGN(4) { KEEP(*(.pfic_iprior57)) }
	.pfic_iprior58 0xe000e43a (NOLOAD): ALIGN(4) { KEEP(*(.pfic_iprior58)) }
	.pfic_iprior59 0xe000e43b (NOLOAD): ALIGN(4) { KEEP(*(.pfic_iprior59)) }
	.pfic_iprior60 0xe000e43c (NOLOAD): ALIGN(4) { KEEP(*(.pfic_iprior60)) }
	.pfic_iprior61 0xe000e43d (NOLOAD): ALIGN(4) { KEEP(*(.pfic_iprior61)) }
	.pfic_iprior62 0xe000e43e (NOLOAD): ALIGN(4) { KEEP(*(.pfic_iprior62)) }
	.pfic_iprior63 0xe000e43f (NOLOAD): ALIGN(4) { KEEP(*(.pfic_iprior63)) }
	.pfic_sctlr 0xe000ed10 (NOLOAD): ALIGN(4) { KEEP(*(.pfic_sctlr)) }
	.pfic_stk_ctlr 0xe000f000 (NOLOAD): ALIGN(4) { KEEP(*(.pfic_stk_ctlr)) }
	.pfic_stk_sr 0xe000f004 (NOLOAD): ALIGN(4) { KEEP(*(.pfic_stk_sr)) }
	.pfic_stk_cntl 0xe000f008 (NOLOAD): ALIGN(4) { KEEP(*(.pfic_stk_cntl)) }
	.pfic_stk_cmplr 0xe000f010 (NOLOAD): ALIGN(4) { KEEP(*(.pfic_stk_cmplr)) }
}